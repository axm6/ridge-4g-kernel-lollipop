## Documentation/devicetree/bindings/input/misc/kxtj2-1009.txt
```
Kionix kxtj2-1009 3-axis accelerometer sensor driver.

Required properties:

 - compatible		: Should be "kionix,accelerometer".
 - reg			: i2c slave address of the device.
 - vdd-supply		: Analog power supply needed to power device.
 - vddio-supply		: Digital IO power supply needed for IO and I2C.
 - kionix,min_interval	: Minimal data polling interval in millisecond.
 - kionix,poll_interval	: Initial data polling interval in millisecond.
 - kionix,accel_direction	: Select which data will be X-axis, Y-axis, Z-axis of reading.
				The sensor measures and reports three axis of data, this property selset
				which data will be interpretd as X-axis, Y-axis and Z-axis gravity data of phone.

 - kionix,accel_irq_use_drdy : Boolean to choose whether or not to use DRDY hardware interrupt mode
				to trigger a data report event instead of using software polling.
				e.g. Give "0" to this property means using software polling.

 - kionix,accel_g_range	: Select initial range of measurement. This define
				the initial configuration of maxinum
				measurement range of the sensor.Where 0 is 2G, 1 is 4G,
				2 is 6G, 3 is 8G, 2G will be used for any other values.

 - kionix,accel_res : Boolean to select output data resolution, if this
				property is defined, sensor will be configured
				to output 12 bits of data, otherwise sensor will
				be configured to output 8 bits data.

Optional properties:

 - interrupt-parent	: Parent of interrupt.
 - interrupts		: Accelerometer interrupts to indicate new data ready or events.

Example:
&i2c_0 { /* BLSP1 QUP2 */
	kionix@e {
		compatible = "kionix,kxtj2-1009";
		reg = <0x0e>;
		interrupt-parent = <&msm_gpio>;
		interrupts = <113 0x2002>;
		vdd-supply = <&pm8916_l17>;
		vio-supply = <&pm8916_l6>;
		kionix,min_interval = <5>;
		kionix,poll_interval = <100>;
		kionix,accel_direction = <1>;
		kionix,accel_irq_use_drdy = <0>;
		kionix,accel_res = <12>;
		kionix,accel_g_range = <2>;
	};
};
```
